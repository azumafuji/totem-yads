## config/west.yml
```yaml
manifest:
  remotes:
    - name: zmkfirmware
      url-base: https://github.com/zmkfirmware
    - name: azumafuji
      url-base: https://github.com/azumafuji
    - name: janpfisher
      url-base: https://github.com/janpfischer
  projects:
    - name: zmk
      remote: zmkfirmware
      revision: v0.2
      import: app/west.yml
    - name: zmk-dongle-screen
      remote: janpfisher
      revision: upgrade-4.1
  self:
    path: config
```
